## meta-fpgh/conf/layer.conf
```bitbake
# copied from assignment 6 code
# We have a conf and classes directory, add to BBPATH
BBPATH .= ":${LAYERDIR}"

# We have recipes-* directories, add to BBFILES
BBFILES += "${LAYERDIR}/recipes-*/*/*.bb \
            ${LAYERDIR}/recipes-*/*/*.bbappend"

BBFILE_COLLECTIONS += "fpgh"
BBFILE_PATTERN_fpgh = "^${LAYERDIR}/"
BBFILE_PRIORITY_fpgh = "6"

LAYERDEPENDS_fpgh = "tegra"
LAYERSERIES_COMPAT_fpgh = "hardknott"
```
